/***************************************************
  Demo for OLED_Zoom library
  This demo is made for a 128*64 OLED with 
  BSD license, all text above must be included in any redistribution
 ****************************************************/

// Set I2C address of your OLED here (usually 0x3D or 0x3C)
#define I2C_ADDRESS 0x3C
// If you are using an OLED with a SH1106 controller, set this to true
//   if you don't know which controller your OLED is using, try with false first
//   then if you have display problems (like only the first row updating or garbage display)
//   change it to true.
// Usually the 1.3'' OLEDs are using SH1106, 0.91'' and 0.96'' are using SSD1306 (and need false below)
#define IS_SH1106 true


 
#include <Wire.h>
#include "OLED_Zoom.h"
// We create 2 matrixes (displaying on the same OLED)
//  of course outside of a demo to demonstrate 2 different zoom levels it doesn't make much sense :)
OLED_Zoom matrix = OLED_Zoom(128, 64, OLEDZoomNoZoom);
OLED_Zoom matrix8 = OLED_Zoom(128, 64, OLEDZoomX8);


#ifndef LED_ON
#define LED_ON 1
#endif

void setup() {
  Serial.begin(9600);
  Serial.println(F("OLED_Zoom Library Demo"));
  // Initialize the OLED screen
  matrix.beginDefault(I2C_ADDRESS, IS_SH1106);
  // Initialization of the second matrix (it will be on the same OLED...)
  matrix8.beginDefault(I2C_ADDRESS, IS_SH1106);
  matrix.clear();
  matrix.display();
}

static const uint8_t PROGMEM
ottoSplash [] = {
  0x00, 0x00, 0x00, 0x00, 0x00, 0x00, 0x00, 0x00, 0x0f, 0xff, 0xff, 0xff, 0xff, 0xff, 0xff, 0xe0,
  0x00, 0x00, 0x00, 0x00, 0x00, 0x00, 0x00, 0x00, 0x10, 0x00, 0x00, 0x00, 0x00, 0x00, 0x00, 0x10,
  0x00, 0x00, 0x00, 0x00, 0x00, 0x00, 0x00, 0x00, 0x20, 0x00, 0x00, 0x00, 0x00, 0x00, 0x00, 0x08,
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  0x00, 0x00, 0x00, 0x00, 0x00, 0x00, 0x00, 0x00, 0x07, 0xff, 0xff, 0xff, 0xff, 0xff, 0xff, 0xc0
},
minibot[] = {0x7e, 0x81, 0xa5, 0x81, 0x7e, 0xff, 0xc3, 0x81},
logo[] = {0x7f, 0x80, 0xba, 0xaf, 0xba, 0x80, 0x80, 0x7f},
logo16[] = {0x7f, 0xfe, 0x80, 0x01, 0xba, 0x5d, 0xaf, 0xf5, 0xba, 0x5d, 0x80, 0x01, 0x80, 0x01, 0x7f, 0xfe},
logo18[] = {0x3f, 0xff, 0x00, 0x40, 0x00, 0x80, 0x5d, 0x2e, 0x80, 0x57, 0xfa, 0x80, 0x5d, 0x2e, 0x80, 0x40,
            0x00, 0x80, 0x40, 0x00, 0x80, 0x3f, 0xff, 0x00
            },
empty[] = {0x00, 0x00, 0x00, 0x00, 0x00, 0x00, 0x00, 0x00},
pupil[] = {0x3c, 0x7e, 0x7a, 0x66, 0x66, 0x7e, 0x7e, 0x3c},
pupil2[] = {0x3c, 0x7e, 0xfb, 0xe7, 0xe7, 0xff, 0x7e, 0x3c},
pupil3[] = {0x00, 0x00, 0x3c, 0x66, 0x3c, 0x00, 0x00, 0x00};

void loop() {

  ///////////////////////
  //  PARTIAL REFRESH ///
  ///////////////////////
  Serial.println(F("PARTIAL REFRESH"));
  // clear matrix
  matrix.clear();
  // refresh full screen
  matrix.display();
  // draw bitmap in buffer
  matrix.drawBitmap(0, 0, ottoSplash, 128, 64, LED_ON);

  // partial refresh to reveal the image on the screen
  for (int i = 0; i < 8; i++) {
    byte y = i;
    int direction = 1;
    for (int j = 0; j < 16; j++) {
      matrix.displayArea(j * 8, y * 8, 8, 8);
      matrix.displayArea((15 - j) * 8, y * 8, 8, 8);
      y += direction;
      if (y < 0 || y > 7) {
        direction = -direction;
        y += direction;
      }
      delay((7 - i) * 3); // We slow it down a bit
    }
  }
  delay(1000);


  ///////////////////////////////////////////////
  //  DIRECT DRAWING OF BITMAPS + INVERT MODE ///
  ///////////////////////////////////////////////
  Serial.println(F("DIRECT DRAWING OF BITMAPS + INVERT MODE"));
  for (int i = 7; i >= 0; i--) {
    matrix.displayBitmap(0, i * 8, ottoSplash, 128, 64, OLEDZoomNoZoom, false, true);
    delay(100);
  }
  delay(1000);
  for (int i = 15; i >= 0; i--) {
    matrix.displayBitmap(i * 8, 0, ottoSplash, 128, 64, OLEDZoomNoZoom, false, true);
    delay(100);
  }
  delay(1000);

  /////////////////////////////////
  //  ZOOM MODE USING BUFFER    ///
  /////////////////////////////////
  Serial.println(F("ZOOM MODE USING BUFFER"));
  // clear matrix
  matrix8.clear();
  // draw logo on empty buffer
  matrix8.drawBitmap(0, 0, logo16, 16, 8, LED_ON);
  // refresh full screen
  matrix8.display();
  delay(1000);

  //////////////////////////////////////////////////////////////////////////////////
  //  FUN WITH displayBitmap: REPLACING PIXELS IN BUFFERS WITH SPRITE ON SCREEN  ///
  //////////////////////////////////////////////////////////////////////////////////
  Serial.println(F("FUN WITH displayBitmap: REPLACING PIXELS IN BUFFERS WITH SPRITE ON SCREEN"));
  for (int i = 0; i < 20; i++) {
    for (int y = 0; y < 8; y++) {
      for (int x = 0; x < 16; x++) {
        if (matrix8.getPixel(x, y)) {
          matrix8.displayBitmap(x * 8, y * 8, minibot, 8, 8, OLEDZoomNoZoom, false, i % 2);
        }
      }
    }
    delay(250);
  }

  //////////////////////////////////////////////////////////
  //  DIRECT DRAWING OF BITMAP WITH DIFFERENT ZOOM LEVELS //
  //////////////////////////////////////////////////////////
  Serial.println(F("DIRECT DRAWING OF BITMAP WITH DIFFERENT ZOOM LEVELS"));
  for (uint8_t repeat = 1; repeat < 8; repeat *= 2) {
    // clear matrix
    matrix8.clear();
    // draw logo on empty buffer
    matrix8.drawBitmap(0, 0, logo16, 16, 8, LED_ON);
    matrix8.display();
    for (int y = 0; y < 8 / repeat; y++) {
      for (int x = 0; x < 128; x++) {
        matrix.displayBitmap(x, y * 8 * repeat, logo18, 17, 8, (OLEDZoomLevel)repeat, false, false);
      }
    }
  }

  /////////////////////////////////////////////////////////
  //  DIRECT DRAWING OF BITMAPS WITH ZOOM & MIRROR MODE  //
  /////////////////////////////////////////////////////////
  // We use a 8*8 bitmap and display it 2 times in mirrored mode to display the full logo
  for (uint8_t repeat = 1; repeat < 16; repeat *= 2) {
      matrix.displayBitmap(64-8*repeat, 24-8*((repeat-1)/2), logo, 8, 8, (OLEDZoomLevel)repeat, false, false);
      matrix.displayBitmap(64, 24-8*((repeat-1)/2), logo, 8, 8, (OLEDZoomLevel)repeat, true, false);
      delay(1000);
  }

    ///////////////////////////////////////////
  //  MIX OF SHAPES ON 8x BUFFER AND BITMAP  //
  /////////////////////////////////////////////
  matrix8.clear();
  matrix8.drawCircle(3,3,3, LED_ON);
  matrix8.drawCircle(12,3,3, LED_ON);
  matrix8.drawRect(7,2,3,2,LED_ON);
  matrix8.display();
  matrix8.displayBitmap(3*8, 3*8, pupil, 8, 8, OLEDZoomNoZoom, false, false);
  matrix8.displayBitmap(12*8, 3*8, pupil, 8, 8, OLEDZoomNoZoom, false, false);
  delay(1000);
  matrix8.displayBitmap(12*8, 3*8, pupil, 8, 8, OLEDZoomNoZoom, false, false);
  delay(200);
  matrix8.displayBitmap(12*8, 3*8, pupil2, 8, 8, OLEDZoomNoZoom, false, false);
  delay(200);
  matrix8.displayBitmap(12*8, 3*8, pupil3, 8, 8, OLEDZoomNoZoom, false, false);
  delay(200);
  matrix8.displayBitmap(12*8, 3*8, pupil2, 8, 8, OLEDZoomNoZoom, false, false);  
  delay(200);
  matrix8.displayBitmap(12*8, 3*8, pupil, 8, 8, OLEDZoomNoZoom, false, false);

  matrix8.clear();
  for (int i=0;i<5;i++) {
    for (int r=-1;r<2;r+=2) {
      for (int x=0;x<25;x++) {
          // Clean inside of circles/eye by refreshing from matrix
          matrix8.displayArea(16,16,24,24);
          matrix8.displayArea(80,80,24,24);
          matrix8.displayBitmap(3*8+r*(x<13 ? x : 25-x), 3*8, pupil, 8, 8, OLEDZoomNoZoom, false, false);
          matrix8.displayBitmap(12*8+r*(x<13 ? x : 25-x), 3*8, pupil, 8, 8, OLEDZoomNoZoom, false, false);     
          delay(20);   
      }
    }
  }
  delay(1000);
}
